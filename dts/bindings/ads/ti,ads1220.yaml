## dts/bindings/ads/ti,ads1220.yaml
```yaml
# Copyright (c) 2026 badjeff
# SPDX-License-Identifier: Apache-2.0

description: Texas Instrument 4 channels SPI ADC

compatible: "ti,ads1220"

include: [adc-controller.yaml, spi-device.yaml]

properties:
  "#io-channel-cells":
    const: 1

  drdy-gpios:
    type: phandle-array
    required: false
    description: |
      GPIO for data ready, becomes active when a conversion result is ready.
      By default, it is active low signal. If not specified, the driver will
      use timed polling based on data rate instead of hardware interrupt.

  low-side-power-switch:
    type: boolean
    description: |
      Enable low-side power switch (PSW). When enabled, the low-side switch
      between AIN3/REFN1 and AVSS is turned on during conversion to reduce
      input leakage current. This is useful for RTD applications.

  pga-bypass:
    type: boolean
    required: false
    description: |
      Bypass the PGA (CONFIG0 bit 0). Only gains 1, 2 and 4 are valid while
      the PGA is bypassed; a higher gain requested by a channel is clamped
      to 4. Note that the driver forces bypass on regardless of this property
      for MUX settings that tie AINN to AVSS (1000-1011) and for the
      REFP/REFN, AVDD/AVSS and shorted-input diagnostic modes (1100-1110),
      so this property only adds a manual bypass on other MUX settings.
      Leaving it unset (default) keeps the PGA enabled everywhere else.

  idac-ua:
    type: int
    required: false
    description: |
      IDAC current setting in microamperes. Configures the excitation current
      sources IDAC1 and IDAC2. Default is 0 (disabled).
      Valid values: 0, 10, 50, 100, 250, 500, 1000, 1500 (in microamperes).
    enum: [0, 10, 50, 100, 250, 500, 1000, 1500]

io-channel-cells:
  - input
```
