## drivers/Kconfig
```kconfig
# Copyright (c) 2026 badjeff
# SPDX-License-Identifier: Apache-2.0

rsource "adc/Kconfig"
rsource "gpio/Kconfig"
rsource "input/Kconfig"
```

## drivers/adc/Kconfig
```kconfig
# Copyright (c) 2026 badjeff
# SPDX-License-Identifier: Apache-2.0

if ADC

rsource "Kconfig.ads1220"

endif # ADC
```

## drivers/adc/Kconfig.ads1220
```kconfig
# Copyright (c) 2026 badjeff
# SPDX-License-Identifier: Apache-2.0

config ADC_ADS1220
	bool "Texas instruments ADS1220"
	default y
	depends on DT_HAS_TI_ADS1220_ENABLED
	select ADC_CONFIGURABLE_INPUTS
	select ADC_CONFIGURABLE_EXCITATION_CURRENT_SOURCE_PIN
	select SPI
	select GPIO
	help
	 Enable the driver for ADS1220 ADC.
```

## drivers/gpio/Kconfig
```kconfig
# Copyright (c) 2026 badjeff
# SPDX-License-Identifier: Apache-2.0

if GPIO

rsource "Kconfig.ads1220_idac"

endif # GPIO
```

## drivers/gpio/Kconfig.ads1220
```kconfig
# Copyright (c) 2026 badjeff
# SPDX-License-Identifier: Apache-2.0

config GPIO_ADS1220
	bool "GPIO ADS1220"
	default y
	depends on DT_HAS_TI_ADS1220_GPIO_ENABLED
	depends on ADC_ADS1220
	help
	  Enable the driver for ADS1220 GPIO.
```

## drivers/gpio/Kconfig.ads1220_idac
```kconfig
# Copyright (c) 2026 badjeff
# SPDX-License-Identifier: Apache-2.0

config GPIO_ADS1220_IDAC
	bool "GPIO ADS1220 IDAC"
	default y
	depends on DT_HAS_TI_ADS1220_IDAC_ENABLED
	depends on ADC_ADS1220
	help
	  Enable the driver for ADS1220 IDAC GPIO.
```

## drivers/input/Kconfig
```kconfig
# Copyright (c) 2026 badjeff
# SPDX-License-Identifier: Apache-2.0

if INPUT

rsource "Kconfig.analog_axis_hires"

endif # INPUT
```

## drivers/input/Kconfig.analog_axis_hires
```kconfig
# Copyright 2023 Google LLC
# SPDX-License-Identifier: Apache-2.0

config INPUT_ANALOG_AXIS_HIRES
	bool "ADC based analog axis input driver (hi-res)"
	default y
	depends on DT_HAS_ANALOG_AXIS_HIRES_ENABLED
	depends on MULTITHREADING
	select ADC
	help
	  ADC based analog axis input driver for high-resolution ADC (24-bit)

if INPUT_ANALOG_AXIS_HIRES

config INPUT_ANALOG_AXIS_HIRES_THREAD_STACK_SIZE
	int "Stack size for the analog axis hires thread"
	default 762
	help
	  Size of the stack used for the analog axis hires thread.

config INPUT_ANALOG_AXIS_HIRES_THREAD_PRIORITY
	int "Priority for the analog axis hires thread"
	default 0
	help
	  Priority level of the analog axis hires thread.

config INPUT_ANALOG_AXIS_HIRES_SETTINGS
	bool "Analog axis hires settings support"
	default y
	depends on SETTINGS
	help
	  Settings support for the analog axis hires driver, exposes a
	  analog_axis_hires_calibration_save() function to save the calibration into
	  settings and load them automatically on startup.

config INPUT_ANALOG_AXIS_HIRES_SETTINGS_MAX_AXES
	int "Maximum number of axes supported in the settings."
	default 8
	help
	  Maximum number of axes that can have calibration value saved in
	  settings.

endif
```

## dts/bindings/gpio/ti,ads1220-gpio.yaml
```yaml
# Copyright (c) 2026 badjeff
# SPDX-License-Identifier: Apache-2.0

description: Texas Instrument ADS1220 IDAC GPIO controller

compatible: "ti,ads1220-gpio"

include: [gpio-controller.yaml]

properties:
  dev-reg:
    type: int
    required: true
    description: |
      ADS1220 instance reg property value. Used to match this GPIO controller
      with the corresponding ADS1220 ADC device.

  idac-ua-high:
    type: int
    required: true
    description: |
      IDAC current (in microamperes) when output pin is set high.
      Valid values: 0, 10, 50, 100, 250, 500, 1000, 2000.
    enum: [0, 10, 50, 100, 250, 500, 1000, 2000]

  idac-ua-low:
    type: int
    required: true
    description: |
      IDAC current (in microamperes) when output pin is set low.
      Valid values: 0, 10, 50, 100, 250, 500, 1000, 2000.
    enum: [0, 10, 50, 100, 250, 500, 1000, 2000]

  skip-reg-write-high:
    type: boolean
    description: |
      If true, skip writing to ADS1220 config register when output is 
      set high. Useful when IDAC is configured via adc-channel's 
      current-source-pin property instead.

  skip-reg-write-low:
    type: boolean
    description: |
      If true, skip writing to ADS1220 config register when output is 
      set low. Useful when IDAC is configured via adc-channel's 
      current-source-pin property instead.

  "#gpio-cells":
    const: 2

gpio-cells:
  - pin
  - flags
```

## dts/bindings/input/analog-axis-hires.yaml
```yaml
# Copyright 2023 Google LLC
# Copyright 2026 badjeff
# SPDX-License-Identifier: Apache-2.0

description: |
  ADC based analog axis input device (high-resolution version)

  Implement an input device generating absolute axis events by periodically
  reading from some ADC channels. This version uses int32_t buffer for
  high-resolution ADCs (16-bit+).

  Example configuration:

  #include <zephyr/dt-bindings/input/input-event-codes.h>

  analog_axis_hires {
          compatible = "analog-axis-hires";
          poll-period-ms = <15>;
          axis-x {
                  io-channels = <&adc 0>;
                  in-deadzone = <50>;
                  in-min = <100>;
                  in-max = <800>;
                  zephyr,axis = <INPUT_ABS_X>;
          };
  };

compatible: "analog-axis-hires"

include: base.yaml

properties:
  poll-period-ms:
    type: int
    default: 15
    description: |
      How often to get new ADC samples for the various configured axes in
      milliseconds. Defaults to 15ms if unspecified.

child-binding:
  properties:
    io-channels:
      type: phandle-array
      required: true
      description: |
        ADC IO channel to use.

    avdd-gpios:
      type: phandle-array
      description: |
        GPIO pin controlling the analog power supply.
        Pin is driven high while sampling this ADC channel.
        Use for multiplexing voltage reference across multiple channels.

    out-min:
      type: int
      default: 0
      description: |
        Minimum value to output on input events. Defaults to 0 if unspecified.

    out-max:
      type: int
      default: 255
      description: |
        Maximum value to output on input events. Defaults to 255 if
        unspecified.

    in-deadzone:
      type: int
      default: 0
      description: |
        Deadzone for the input center value. If specified input values between
        the center of the range plus or minus this value will be reported as
        center. Defaults to 0, no deadzone.

    in-min:
      type: int
      required: true
      description: |
        Input value that corresponds to the minimum output value.

    in-max:
      type: int
      required: true
      description: |
        Input value that corresponds to the maximum output value.

    zephyr,axis-type:
      type: int
      required: true
      description: |
        The input type for the axis to report for the device, typically any of
        INPUT_EV_*.

    zephyr,axis:
      type: int
      required: true
      description: |
        The input code for the axis to report for the device, typically any of
        INPUT_ABS_* or INPUT_REL_*.

    invert-input:
      type: boolean
      description: |
        If set, invert the raw ADC value before processing it. Useful for
        differential channels.

    invert-output:
      type: boolean
      description: |
        If set, invert the output value.

    skip-change-comparator:
      type: boolean
      description: |
        Skip the change comparator and report all sampled values.
        By default, only reports values that differ from the previous reading.

    in-calib-cycle:
      type: int
      description: |
        Number of samples to collect for auto-calibration.
        When set, captures the floating neutral values over this many samples.
        The DT-specified in-min and in-max define the full range; calibrated
        min/max will be shifted to align with the average of the neutral values.

    in-deadzone-calib-scale-pctg:
      type: int
      description: |
        Percentage of calibration range to use as deadzone.
        Scales the measured min-max range from calibration to set the deadzone.
        Use to filter noise/extreme samples during calibration.
```
